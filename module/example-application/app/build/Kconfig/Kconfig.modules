## module/example-application/app/build/Kconfig/Kconfig.modules
```kconfig
menu "example-application (/Users/kaiquecipola/my-workspace/example-application)"
osource "/Users/kaiquecipola/my-workspace/example-application/Kconfig"
config ZEPHYR_EXAMPLE_APPLICATION_MODULE
	bool
	default y
endmenu
menu "cmsis (/Users/kaiquecipola/my-workspace/modules/hal/cmsis)"
osource "$(ZEPHYR_CMSIS_KCONFIG)"
config ZEPHYR_CMSIS_MODULE
	bool
	default y
endmenu
menu "hal_nordic (/Users/kaiquecipola/my-workspace/modules/hal/nordic)"
osource "$(ZEPHYR_HAL_NORDIC_KCONFIG)"
config ZEPHYR_HAL_NORDIC_MODULE
	bool
	default y

config ZEPHYR_HAL_NORDIC_MODULE_BLOBS
	bool
endmenu
config ZEPHYR_HAL_STM32_MODULE
	bool
	default y

config ZEPHYR_HAL_STM32_MODULE_BLOBS
	bool
```

## module/example-application/app/build/Kconfig/Kconfig.shield
```kconfig
osource "/Users/kaiquecipola/my-workspace/example-application/boards/shields/*/Kconfig.shield"
```

## module/example-application/app/build/Kconfig/Kconfig.shield.defconfig
```kconfig
osource "C:/Users/finan/my-workspace/example-application/boards/shields/*/Kconfig.defconfig"
```

## module/example-application/app/build/Kconfig/arch/Kconfig
```kconfig
# Load Zephyr Arch Kconfig descriptions.
osource "/Users/kaiquecipola/my-workspace/zephyr/arch/x86/Kconfig"
osource "/Users/kaiquecipola/my-workspace/zephyr/arch/xtensa/Kconfig"
osource "/Users/kaiquecipola/my-workspace/zephyr/arch/sparc/Kconfig"
osource "/Users/kaiquecipola/my-workspace/zephyr/arch/riscv/Kconfig"
osource "/Users/kaiquecipola/my-workspace/zephyr/arch/posix/Kconfig"
osource "/Users/kaiquecipola/my-workspace/zephyr/arch/nios2/Kconfig"
osource "/Users/kaiquecipola/my-workspace/zephyr/arch/mips/Kconfig"
osource "/Users/kaiquecipola/my-workspace/zephyr/arch/arm64/Kconfig"
osource "/Users/kaiquecipola/my-workspace/zephyr/arch/arm/Kconfig"
osource "/Users/kaiquecipola/my-workspace/zephyr/arch/arc/Kconfig"
```

## module/example-application/app/build/Kconfig/boards/Kconfig
```kconfig
# Load Zephyr board Kconfig descriptions.
osource "C:/Users/finan/my-workspace/zephyr/boards/qemu/x86/Kconfig"
```

## module/example-application/app/build/Kconfig/boards/Kconfig.defconfig
```kconfig
# Load Zephyr board defconfig descriptions.
osource "/Users/kaiquecipola/my-workspace/zephyr/boards/qemu/cortex_a53/Kconfig.defconfig"
```

## module/example-application/app/build/Kconfig/boards/Kconfig.qemu_cortex_a53
```kconfig
# Load board Kconfig descriptions.
osource "/Users/kaiquecipola/my-workspace/zephyr/boards/qemu/cortex_a53/Kconfig.qemu_cortex_a53"
```

## module/example-application/app/build/Kconfig/boards/Kconfig.sysbuild
```kconfig
# Load Sysbuild board Kconfig descriptions.
osource "/Users/kaiquecipola/my-workspace/zephyr/boards/qemu/cortex_a53/Kconfig.sysbuild"
```

## module/example-application/app/build/Kconfig/soc/Kconfig
```kconfig
# Load Zephyr SoC Kconfig descriptions.
osource "/Users/kaiquecipola/my-workspace/zephyr/soc/xlnx/zynqmp/Kconfig"
osource "/Users/kaiquecipola/my-workspace/zephyr/soc/xlnx/zynq7000/Kconfig"
osource "/Users/kaiquecipola/my-workspace/zephyr/soc/xen/Kconfig"
osource "/Users/kaiquecipola/my-workspace/zephyr/soc/wch/ch32v/Kconfig"
osource "/Users/kaiquecipola/my-workspace/zephyr/soc/ti/simplelink/Kconfig"
osource "/Users/kaiquecipola/my-workspace/zephyr/soc/ti/lm3s6965/Kconfig"
osource "/Users/kaiquecipola/my-workspace/zephyr/soc/ti/k3/Kconfig"
osource "/Users/kaiquecipola/my-workspace/zephyr/soc/telink/tlsr/Kconfig"
osource "/Users/kaiquecipola/my-workspace/zephyr/soc/starfive/jh71xx/Kconfig"
osource "/Users/kaiquecipola/my-workspace/zephyr/soc/st/stm32/Kconfig"
osource "/Users/kaiquecipola/my-workspace/zephyr/soc/snps/qemu_arc/Kconfig"
osource "/Users/kaiquecipola/my-workspace/zephyr/soc/snps/nsim/arc_v/Kconfig"
osource "/Users/kaiquecipola/my-workspace/zephyr/soc/snps/nsim/arc_classic/Kconfig"
osource "/Users/kaiquecipola/my-workspace/zephyr/soc/snps/hsdk4xd/Kconfig"
osource "/Users/kaiquecipola/my-workspace/zephyr/soc/snps/hsdk/Kconfig"
osource "/Users/kaiquecipola/my-workspace/zephyr/soc/snps/emsk/Kconfig"
osource "/Users/kaiquecipola/my-workspace/zephyr/soc/snps/emsdp/Kconfig"
osource "/Users/kaiquecipola/my-workspace/zephyr/soc/snps/arc_iot/Kconfig"
osource "/Users/kaiquecipola/my-workspace/zephyr/soc/silabs/Kconfig"
osource "/Users/kaiquecipola/my-workspace/zephyr/soc/sifive/sifive_freedom/Kconfig"
osource "/Users/kaiquecipola/my-workspace/zephyr/soc/sensry/Kconfig"
osource "/Users/kaiquecipola/my-workspace/zephyr/soc/rockchip/Kconfig"
osource "/Users/kaiquecipola/my-workspace/zephyr/soc/renode/riscv_virtual/Kconfig"
osource "/Users/kaiquecipola/my-workspace/zephyr/soc/renode/cortex_r8_virtual/Kconfig"
osource "/Users/kaiquecipola/my-workspace/zephyr/soc/renesas/smartbond/Kconfig"
osource "/Users/kaiquecipola/my-workspace/zephyr/soc/renesas/rzt2m/Kconfig"
osource "/Users/kaiquecipola/my-workspace/zephyr/soc/renesas/rz/Kconfig"
osource "/Users/kaiquecipola/my-workspace/zephyr/soc/renesas/rcar/Kconfig"
osource "/Users/kaiquecipola/my-workspace/zephyr/soc/renesas/ra/Kconfig"
osource "/Users/kaiquecipola/my-workspace/zephyr/soc/realtek/ec/Kconfig"
osource "/Users/kaiquecipola/my-workspace/zephyr/soc/raspberrypi/rpi_pico/Kconfig"
osource "/Users/kaiquecipola/my-workspace/zephyr/soc/quicklogic/eos_s3/Kconfig"
osource "/Users/kaiquecipola/my-workspace/zephyr/soc/qemu/virt_riscv/Kconfig"
osource "/Users/kaiquecipola/my-workspace/zephyr/soc/qemu/malta/Kconfig"
osource "/Users/kaiquecipola/my-workspace/zephyr/soc/openisa/rv32m1/Kconfig"
osource "/Users/kaiquecipola/my-workspace/zephyr/soc/oct/osd32mp15x/Kconfig"
osource "/Users/kaiquecipola/my-workspace/zephyr/soc/nxp/s32/Kconfig"
osource "/Users/kaiquecipola/my-workspace/zephyr/soc/nxp/rw/Kconfig"
osource "/Users/kaiquecipola/my-workspace/zephyr/soc/nxp/mcx/Kconfig"
osource "/Users/kaiquecipola/my-workspace/zephyr/soc/nxp/lpc/Kconfig"
osource "/Users/kaiquecipola/my-workspace/zephyr/soc/nxp/layerscape/Kconfig"
osource "/Users/kaiquecipola/my-workspace/zephyr/soc/nxp/kinetis/Kconfig"
osource "/Users/kaiquecipola/my-workspace/zephyr/soc/nxp/imxrt/Kconfig"
osource "/Users/kaiquecipola/my-workspace/zephyr/soc/nxp/imx/Kconfig"
osource "/Users/kaiquecipola/my-workspace/zephyr/soc/nuvoton/numicro/Kconfig"
osource "/Users/kaiquecipola/my-workspace/zephyr/soc/nuvoton/numaker/Kconfig"
osource "/Users/kaiquecipola/my-workspace/zephyr/soc/nuvoton/npcx/Kconfig"
osource "/Users/kaiquecipola/my-workspace/zephyr/soc/nuvoton/npcm/Kconfig"
osource "/Users/kaiquecipola/my-workspace/zephyr/soc/nordic/Kconfig"
osource "/Users/kaiquecipola/my-workspace/zephyr/soc/neorv32/Kconfig"
osource "/Users/kaiquecipola/my-workspace/zephyr/soc/native/inf_clock/Kconfig"
osource "/Users/kaiquecipola/my-workspace/zephyr/soc/microchip/miv/Kconfig"
osource "/Users/kaiquecipola/my-workspace/zephyr/soc/microchip/mec/Kconfig"
osource "/Users/kaiquecipola/my-workspace/zephyr/soc/mediatek/mt8xxx/Kconfig"
osource "/Users/kaiquecipola/my-workspace/zephyr/soc/lowrisc/opentitan/Kconfig"
osource "/Users/kaiquecipola/my-workspace/zephyr/soc/litex/litex_vexriscv/Kconfig"
osource "/Users/kaiquecipola/my-workspace/zephyr/soc/ite/ec/Kconfig"
osource "/Users/kaiquecipola/my-workspace/zephyr/soc/intel/raptor_lake/Kconfig"
osource "/Users/kaiquecipola/my-workspace/zephyr/soc/intel/lakemont/Kconfig"
osource "/Users/kaiquecipola/my-workspace/zephyr/soc/intel/intel_socfpga_std/Kconfig"
osource "/Users/kaiquecipola/my-workspace/zephyr/soc/intel/intel_socfpga/Kconfig"
osource "/Users/kaiquecipola/my-workspace/zephyr/soc/intel/intel_niosv/Kconfig"
osource "/Users/kaiquecipola/my-workspace/zephyr/soc/intel/intel_ish/Kconfig"
osource "/Users/kaiquecipola/my-workspace/zephyr/soc/intel/intel_adsp/Kconfig"
osource "/Users/kaiquecipola/my-workspace/zephyr/soc/intel/elkhart_lake/Kconfig"
osource "/Users/kaiquecipola/my-workspace/zephyr/soc/intel/atom/Kconfig"
osource "/Users/kaiquecipola/my-workspace/zephyr/soc/intel/apollo_lake/Kconfig"
osource "/Users/kaiquecipola/my-workspace/zephyr/soc/intel/alder_lake/Kconfig"
osource "/Users/kaiquecipola/my-workspace/zephyr/soc/infineon/cat3/Kconfig"
osource "/Users/kaiquecipola/my-workspace/zephyr/soc/infineon/cat1b/Kconfig"
osource "/Users/kaiquecipola/my-workspace/zephyr/soc/infineon/cat1a/Kconfig"
osource "/Users/kaiquecipola/my-workspace/zephyr/soc/gd/gd32/Kconfig"
osource "/Users/kaiquecipola/my-workspace/zephyr/soc/gaisler/leon3/Kconfig"
osource "/Users/kaiquecipola/my-workspace/zephyr/soc/gaisler/gr716a/Kconfig"
osource "/Users/kaiquecipola/my-workspace/zephyr/soc/espressif/Kconfig"
osource "/Users/kaiquecipola/my-workspace/zephyr/soc/ene/kb1200/Kconfig"
osource "/Users/kaiquecipola/my-workspace/zephyr/soc/efinix/sapphire/Kconfig"
osource "/Users/kaiquecipola/my-workspace/zephyr/soc/cdns/xtensa_sample_controller/Kconfig"
osource "/Users/kaiquecipola/my-workspace/zephyr/soc/cdns/sample_controller32/Kconfig"
osource "/Users/kaiquecipola/my-workspace/zephyr/soc/cdns/dc233c/Kconfig"
osource "/Users/kaiquecipola/my-workspace/zephyr/soc/brcm/bcmvk/Kconfig"
osource "/Users/kaiquecipola/my-workspace/zephyr/soc/brcm/bcm2712/Kconfig"
osource "/Users/kaiquecipola/my-workspace/zephyr/soc/brcm/bcm2711/Kconfig"
osource "/Users/kaiquecipola/my-workspace/zephyr/soc/atmel/sam0/Kconfig"
osource "/Users/kaiquecipola/my-workspace/zephyr/soc/atmel/sam/Kconfig"
osource "/Users/kaiquecipola/my-workspace/zephyr/soc/aspeed/Kconfig"
osource "/Users/kaiquecipola/my-workspace/zephyr/soc/arm/Kconfig"
osource "/Users/kaiquecipola/my-workspace/zephyr/soc/arm/beetle/Kconfig"
osource "/Users/kaiquecipola/my-workspace/zephyr/soc/antmicro/myra/Kconfig"
osource "/Users/kaiquecipola/my-workspace/zephyr/soc/andestech/Kconfig"
osource "/Users/kaiquecipola/my-workspace/zephyr/soc/amd/acp_6_0/Kconfig"
osource "/Users/kaiquecipola/my-workspace/zephyr/soc/ambiq/Kconfig"
osource "/Users/kaiquecipola/my-workspace/zephyr/soc/altr/zephyr_nios2f/Kconfig"
osource "/Users/kaiquecipola/my-workspace/zephyr/soc/altr/qemu_nios2/Kconfig"
osource "/Users/kaiquecipola/my-workspace/zephyr/soc/adi/max32/Kconfig"
```
